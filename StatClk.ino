#include <Arduino.h>
#include <Wire.h>
#include <LiquidCrystal_I2C.h>
#include <WiFi.h>
#include <WebServer.h>
#include <pgmspace.h>

// =====================================================
// WIFI
// =====================================================

const char* WIFI_SSID = "......";
const char* WIFI_PASSWORD = "......";


// =====================================================
// WEB SERVER
// =====================================================

WebServer server(80);


// =====================================================
// OLED SETTINGS
// =====================================================

#define OLED_ADDRESS 0x3C
#define OLED_WIDTH   128
#define OLED_HEIGHT  64


// =====================================================
// OLED 1 IMAGES
//
// Replace each placeholder with your 128x64 bitmap.
//
// Each image must contain 1024 bytes.
// =====================================================

const uint8_t oled1Image1[] PROGMEM = {
	0x00, 0x10, 0x00, 0x00, 0x00, 0x00, 0x80, 0x00, 0x00, 0x00, 0x00, 0x00, 0x00, 0x00, 0x00, 0x00, 
	0x00, 0x10, 0x00, 0x00, 0x00, 0x00, 0x40, 0x75, 0x5c, 0x5c, 0x71, 0xdd, 0xdc, 0x00, 0x00, 0x00, 
	0x00, 0x20, 0x00, 0x00, 0x00, 0x00, 0x20, 0x27, 0x50, 0x50, 0x50, 0x99, 0x08, 0x00, 0x00, 0x00, 
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	0xe5, 0x55, 0x5f, 0xff, 0xfe, 0x01, 0xf0, 0x6a, 0xff, 0xff, 0xce, 0xee, 0xee, 0x25, 0x4c, 0x4c
};

const uint8_t oled1Image2[] PROGMEM = {
	0x00, 0x00, 0x00, 0x00, 0x00, 0x00, 0x00, 0x00, 0x00, 0x00, 0x00, 0x00, 0x00, 0x00, 0x00, 0x00, 
	0x00, 0x00, 0x00, 0x00, 0x00, 0x00, 0x00, 0x00, 0x00, 0x00, 0x00, 0x00, 0x00, 0x00, 0x00, 0x00, 
	0x00, 0x00, 0x00, 0x00, 0x00, 0x00, 0x00, 0x00, 0x00, 0x00, 0x00, 0x00, 0x00, 0x00, 0x00, 0x00, 
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	0x00, 0x00, 0x00, 0x00, 0x00, 0x00, 0x00, 0x00, 0x00, 0x00, 0x00, 0x00, 0x00, 0x00, 0x00, 0x00
};

const uint8_t oled1Image3[] PROGMEM = {
	0xff, 0xff, 0xff, 0xff, 0xff, 0xff, 0xff, 0xff, 0xff, 0xff, 0xff, 0xff, 0xff, 0xff, 0xff, 0xff, 
	0xff, 0xff, 0xff, 0xff, 0xff, 0xff, 0xff, 0xff, 0xff, 0xff, 0xff, 0xff, 0xff, 0xff, 0xff, 0xff, 
	0xff, 0xff, 0xff, 0xff, 0xff, 0xff, 0xff, 0xff, 0xff, 0xff, 0xff, 0xff, 0xff, 0xff, 0xff, 0xff, 
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	0xff, 0xff, 0xff, 0xfd, 0x00, 0x02, 0xff, 0xff, 0xff, 0xff, 0xff, 0xff, 0xff, 0xff, 0xff, 0xff
};


// =====================================================
// OLED 4 IMAGES
//
// Replace each placeholder with your 128x64 bitmap.
// =====================================================

const uint8_t oled4Image1[] PROGMEM = {
	0x00, 0x00, 0x00, 0x00, 0x00, 0x00, 0x00, 0x7f, 0xff, 0xff, 0xfe, 0x40, 0x07, 0xff, 0xff, 0xff, 
	0x00, 0x00, 0x00, 0x00, 0x00, 0x00, 0x00, 0x7f, 0xff, 0xff, 0xff, 0x20, 0x0b, 0xff, 0xff, 0xff, 
	0x00, 0x00, 0x00, 0x00, 0x00, 0x00, 0x00, 0xff, 0xff, 0xff, 0xff, 0x80, 0x07, 0xff, 0xff, 0xff, 
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	0x3d, 0xc8, 0x27, 0xfb, 0xd0, 0x17, 0x1f, 0x11, 0x8a, 0x2c, 0x1f, 0xff, 0x7b, 0x50, 0x38, 0x10
};

const uint8_t oled4Image2[] PROGMEM = {
	0xff, 0xff, 0xff, 0xff, 0xff, 0xff, 0xff, 0xff, 0xff, 0xff, 0xff, 0xff, 0xff, 0xff, 0xff, 0xff, 
	0xff, 0xff, 0xff, 0xff, 0xff, 0xff, 0xff, 0xff, 0xff, 0xff, 0xff, 0xff, 0xff, 0xff, 0xff, 0xff, 
	0xff, 0xff, 0xff, 0xff, 0xff, 0xff, 0xff, 0xff, 0xff, 0xff, 0xff, 0xff, 0xff, 0xff, 0xff, 0xff, 
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	0xff, 0xff, 0xff, 0xff, 0xff, 0xff, 0xff, 0xff, 0xff, 0xff, 0xff, 0xff, 0xff, 0xff, 0xff, 0xff
};

const uint8_t oled4Image3[] PROGMEM = {
	0x00, 0x00, 0x00, 0x00, 0x00, 0x00, 0x00, 0x00, 0x00, 0x00, 0x00, 0x00, 0x00, 0x00, 0x00, 0x00, 
	0x00, 0x00, 0x00, 0x00, 0x00, 0x00, 0x00, 0x00, 0x00, 0x00, 0x00, 0x3f, 0x80, 0x00, 0x00, 0x00, 
	0x00, 0x00, 0x00, 0x00, 0x00, 0x00, 0x00, 0x00, 0x00, 0x00, 0x01, 0xff, 0xe0, 0x00, 0x00, 0x00, 
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	0x00, 0x00, 0x00, 0x0f, 0xe1, 0x00, 0x00, 0x7f, 0xff, 0xff, 0xff, 0x80, 0x0f, 0xc0, 0x00, 0x00
};



// =====================================================
// SOFTWARE I2C CLASS
// =====================================================

class SoftwareI2C {

  private:

    int SDA_PIN;
    int SCL_PIN;

    void sdaHigh() {
      pinMode(SDA_PIN, INPUT_PULLUP);
    }

    void sdaLow() {
      pinMode(SDA_PIN, OUTPUT);
      digitalWrite(SDA_PIN, LOW);
    }

    void sclHigh() {
      pinMode(SCL_PIN, INPUT_PULLUP);
    }

    void sclLow() {
      pinMode(SCL_PIN, OUTPUT);
      digitalWrite(SCL_PIN, LOW);
    }

    void delayI2C() {
      delayMicroseconds(10);
    }

  public:

    SoftwareI2C(int sda, int scl) {

      SDA_PIN = sda;
      SCL_PIN = scl;

      pinMode(SDA_PIN, INPUT_PULLUP);
      pinMode(SCL_PIN, INPUT_PULLUP);
    }


    void begin() {

      sdaHigh();
      sclHigh();

      delay(10);
    }


    void start() {

      sdaHigh();
      sclHigh();
      delayI2C();

      sdaLow();
      delayI2C();

      sclLow();
    }


    void stop() {

      sdaLow();
      delayI2C();

      sclHigh();
      delayI2C();

      sdaHigh();
      delayI2C();
    }


    bool writeByte(uint8_t data) {

      for (int i = 0; i < 8; i++) {

        if (data & 0x80) {
          sdaHigh();
        } else {
          sdaLow();
        }

        sclHigh();
        delayI2C();

        sclLow();
        delayI2C();

        data <<= 1;
      }

      // ACK

      sdaHigh();

      sclHigh();
      delayI2C();

      bool ack = (digitalRead(SDA_PIN) == LOW);

      sclLow();
      delayI2C();

      return ack;
    }


    void command(uint8_t cmd) {

      start();

      writeByte((OLED_ADDRESS << 1) | 0);

      writeByte(0x00);

      writeByte(cmd);

      stop();
    }


    void initOLED() {

      begin();

      command(0xAE); // Display OFF

      command(0xD5);
      command(0x80);

      command(0xA8);
      command(0x3F);

      command(0xD3);
      command(0x00);

      command(0x40);

      command(0x8D);
      command(0x14);

      command(0x20);
      command(0x00);

      command(0xA1);

      command(0xC8);

      command(0xDA);
      command(0x12);

      command(0x81);
      command(0xCF);

      command(0xD9);
      command(0xF1);

      command(0xDB);
      command(0x40);

      command(0xA4);

      command(0xA6);

      command(0xAF); // Display ON
    }


    void displayBitmap(const uint8_t *bitmap) {

      uint8_t pageBuffer[128];

      for (int page = 0; page < 8; page++) {

        for (int x = 0; x < 128; x++) {

          uint8_t value = 0;

          for (int bit = 0; bit < 8; bit++) {

            int y = page * 8 + bit;

            int byteIndex = (y * 16) + (x / 8);

            uint8_t sourceByte =
              pgm_read_byte(&bitmap[byteIndex]);

            uint8_t mask =
              0x80 >> (x & 7);

            if (sourceByte & mask) {
              value |= (1 << bit);
            }
          }

          pageBuffer[x] = value;
        }


        command(0xB0 + page);

        command(0x00);

        command(0x10);


        start();

        writeByte((OLED_ADDRESS << 1) | 0);

        writeByte(0x40);


        for (int x = 0; x < 128; x++) {
          writeByte(pageBuffer[x]);
        }

        stop();
      }
    }
};


// =====================================================
// OLED INSTANCES
//
// OLED 1 -> SDA 21 / SCL 22
// OLED 2 -> SDA 25 / SCL 26
// OLED 3 -> SDA 32 / SCL 33
// OLED 4 -> SDA 16 / SCL 17
// =====================================================

SoftwareI2C oled1(21, 22);
SoftwareI2C oled2(25, 26);
SoftwareI2C oled3(32, 33);
SoftwareI2C oled4(16, 17);


// =====================================================
// LCD
//
// SDA -> GPIO18
// SCL -> GPIO19
// Address -> 0x27
// =====================================================

LiquidCrystal_I2C lcd(0x27, 16, 2);


// =====================================================
// IMAGE CONTROL
// =====================================================

int oled1Image = 0;
// 0 = auto
// 1 = image 1
// 2 = image 2
// 3 = image 3

int oled4Image = 0;

unsigned long lastImageChange = 0;

const unsigned long IMAGE_INTERVAL = 10000;

int oled1CurrentImage = 0;
int oled4CurrentImage = 0;


// =====================================================
// TIME / DATE
// =====================================================

int currentHour = 0;
int currentMinute = 0;
int currentSecond = 0;

int currentDay = 1;
int currentMonth = 1;
int currentYear = 2026;

unsigned long lastTimeSync = 0;
unsigned long lastLocalSecond = 0;

bool timeReceived = false;


// =====================================================
// TEMPERATURE
// =====================================================

float temperature = 0.0;

bool temperatureReceived = false;

unsigned long lastTemperatureUpdate = 0;


// =====================================================
// LCD TEXT
// =====================================================

String lcdLine1 = "ESP32 DISPLAY";
String lcdLine2 = "CONNECTED";


// =====================================================
// TIME CALCULATION
// =====================================================

void advanceTime() {

  if (!timeReceived) {
    return;
  }


  unsigned long now = millis();


  while (now - lastLocalSecond >= 1000) {

    lastLocalSecond += 1000;

    currentSecond++;


    if (currentSecond >= 60) {

      currentSecond = 0;

      currentMinute++;


      if (currentMinute >= 60) {

        currentMinute = 0;

        currentHour++;


        if (currentHour >= 24) {

          currentHour = 0;

          currentDay++;


          // Simple month lengths
          int daysInMonth = 31;


          if (currentMonth == 4 ||
              currentMonth == 6 ||
              currentMonth == 9 ||
              currentMonth == 11) {

            daysInMonth = 30;
          }


          if (currentMonth == 2) {

            daysInMonth = 28;

            // Leap year
            if ((currentYear % 4 == 0 &&
                 currentYear % 100 != 0) ||
                (currentYear % 400 == 0)) {

              daysInMonth = 29;
            }
          }


          if (currentDay > daysInMonth) {

            currentDay = 1;

            currentMonth++;


            if (currentMonth > 12) {

              currentMonth = 1;

              currentYear++;
            }
          }
        }
      }
    }
  }
}


// =====================================================
// UPDATE OLED 2
//
// Large hour
// Small date underneath
//
// Example:
//
//       14
//   10/09/2026
// =====================================================

void updateOLED2() {

  // This OLED uses the same bitmap driver as your
  // previous code.
  //
  // For now we create the display using a generated
  // text bitmap below.

}


// =====================================================
// SIMPLE OLED TEXT RENDERING
//
// 5x7 font
// =====================================================

const uint8_t font5x7[][5] PROGMEM = {

  // 0
  {0x3E,0x51,0x49,0x45,0x3E},

  // 1
  {0x00,0x42,0x7F,0x40,0x00},

  // 2
  {0x42,0x61,0x51,0x49,0x46},

  // 3
  {0x21,0x41,0x45,0x4B,0x31},

  // 4
  {0x18,0x14,0x12,0x7F,0x10},

  // 5
  {0x27,0x45,0x45,0x45,0x39},

  // 6
  {0x3C,0x4A,0x49,0x49,0x30},

  // 7
  {0x01,0x71,0x09,0x05,0x03},

  // 8
  {0x36,0x49,0x49,0x49,0x36},

  // 9
  {0x06,0x49,0x49,0x29,0x1E},

  // :
  {0x00,0x36,0x36,0x00,0x00},

  // /
  {0x20,0x10,0x08,0x04,0x02},

  // C
  {0x3E,0x41,0x41,0x41,0x22},

  // degree symbol
  {0x06,0x09,0x09,0x06,0x00},

  // space
  {0x00,0x00,0x00,0x00,0x00}
};


int fontIndex(char c) {

  if (c >= '0' && c <= '9') {
    return c - '0';
  }

  if (c == ':') return 10;

  if (c == '/') return 11;

  if (c == 'C') return 12;

  if (c == '*') return 13;

  return 14;
}


// =====================================================
// CREATE TEXT BUFFER
// =====================================================

void clearBuffer(uint8_t *buffer) {

  for (int i = 0; i < 1024; i++) {
    buffer[i] = 0;
  }
}


// =====================================================
// DRAW CHARACTER INTO XBMP BUFFER
// =====================================================

void drawChar(
  uint8_t *buffer,
  char c,
  int x,
  int y,
  int scale
) {

  int index = fontIndex(c);


  for (int col = 0; col < 5; col++) {

    uint8_t column =
      pgm_read_byte(&font5x7[index][col]);


    for (int row = 0; row < 7; row++) {

      if (column & (1 << row)) {

        for (int sx = 0; sx < scale; sx++) {

          for (int sy = 0; sy < scale; sy++) {

            int px = x + col * scale + sx;

            int py = y + row * scale + sy;


            if (px < 0 ||
                px >= 128 ||
                py < 0 ||
                py >= 64) {

              continue;
            }


            int byteIndex =
              py * 16 + (px / 8);


            uint8_t mask =
              0x80 >> (px & 7);


            buffer[byteIndex] |= mask;
          }
        }
      }
    }
  }
}


// =====================================================
// DRAW TEXT
// =====================================================

void drawText(
  uint8_t *buffer,
  const char *text,
  int x,
  int y,
  int scale
) {

  while (*text) {

    drawChar(
      buffer,
      *text,
      x,
      y,
      scale
    );

    x += 6 * scale;

    text++;
  }
}


// =====================================================
// OLED 2 DISPLAY
// =====================================================

void refreshOLED2() {

  uint8_t buffer[1024];

  clearBuffer(buffer);


  char hourText[3];

  snprintf(
    hourText,
    sizeof(hourText),
    "%02d",
    currentHour
  );


  char dateText[11];

  snprintf(
    dateText,
    sizeof(dateText),
    "%02d/%02d/%04d",
    currentDay,
    currentMonth,
    currentYear
  );


  // Large hour

  int hourWidth = 2 * 6 * 6;

  int hourX =
    (128 - hourWidth) / 2;

  drawText(
    buffer,
    hourText,
    hourX,
    5,
    6
  );


  // Small date

  int dateWidth = 10 * 6 * 2;

  int dateX =
    (128 - dateWidth) / 2;

  drawText(
    buffer,
    dateText,
    dateX,
    50,
    2
  );


  // Display using same OLED protocol

  uint8_t pageBuffer[128];


  for (int page = 0; page < 8; page++) {

    for (int x = 0; x < 128; x++) {

      uint8_t value = 0;


      for (int bit = 0; bit < 8; bit++) {

        int y =
          page * 8 + bit;


        int byteIndex =
          y * 16 + x / 8;


        uint8_t sourceByte =
          buffer[byteIndex];


        uint8_t mask =
          0x80 >> (x & 7);


        if (sourceByte & mask) {

          value |=
            (1 << bit);
        }
      }


      pageBuffer[x] = value;
    }


    oled2.command(0xB0 + page);

    oled2.command(0x00);

    oled2.command(0x10);


    oled2.start();

    oled2.writeByte(
      (OLED_ADDRESS << 1) | 0
    );

    oled2.writeByte(0x40);


    for (int x = 0; x < 128; x++) {

      oled2.writeByte(
        pageBuffer[x]
      );
    }


    oled2.stop();
  }
}


// =====================================================
// OLED 3 DISPLAY
//
// Large minutes
// Small temperature underneath
//
// Example:
//
//       37
//      24°C
// =====================================================

void refreshOLED3() {

  uint8_t buffer[1024];

  clearBuffer(buffer);


  char minuteText[3];

  snprintf(
    minuteText,
    sizeof(minuteText),
    "%02d",
    currentMinute
  );


  char tempText[10];


  if (temperatureReceived) {

    int tempRounded =
      (int)round(temperature);


    snprintf(
      tempText,
      sizeof(tempText),
      "%d*C",
      tempRounded
    );

  } else {

    strcpy(
      tempText,
      "--*C"
    );
  }


  // Large minutes

  int minuteWidth =
    2 * 6 * 6;

  int minuteX =
    (128 - minuteWidth) / 2;


  drawText(
    buffer,
    minuteText,
    minuteX,
    5,
    6
  );


  // Temperature

  int tempLength =
    strlen(tempText);


  int tempWidth =
    tempLength * 6 * 2;


  int tempX =
    (128 - tempWidth) / 2;


  drawText(
    buffer,
    tempText,
    tempX,
    50,
    2
  );


  // Send buffer to OLED 3

  uint8_t pageBuffer[128];


  for (int page = 0; page < 8; page++) {

    for (int x = 0; x < 128; x++) {

      uint8_t value = 0;


      for (int bit = 0; bit < 8; bit++) {

        int y =
          page * 8 + bit;


        int byteIndex =
          y * 16 + x / 8;


        uint8_t sourceByte =
          buffer[byteIndex];


        uint8_t mask =
          0x80 >> (x & 7);


        if (sourceByte & mask) {

          value |=
            (1 << bit);
        }
      }


      pageBuffer[x] = value;
    }


    oled3.command(0xB0 + page);

    oled3.command(0x00);

    oled3.command(0x10);


    oled3.start();

    oled3.writeByte(
      (OLED_ADDRESS << 1) | 0
    );

    oled3.writeByte(0x40);


    for (int x = 0; x < 128; x++) {

      oled3.writeByte(
        pageBuffer[x]
      );
    }


    oled3.stop();
  }
}


// =====================================================
// UPDATE LCD
// =====================================================

void updateLCD() {

  lcd.clear();


  lcd.setCursor(0, 0);

  lcd.print(lcdLine1);


  lcd.setCursor(0, 1);

  lcd.print(lcdLine2);
}


// =====================================================
// SHOW IMAGE ON OLED 1
// =====================================================

void showOLED1Image(int image) {

  if (image == 1) {

    oled1.displayBitmap(
      oled1Image1
    );
  }

  else if (image == 2) {

    oled1.displayBitmap(
      oled1Image2
    );
  }

  else {

    oled1.displayBitmap(
      oled1Image3
    );
  }
}


// =====================================================
// SHOW IMAGE ON OLED 4
// =====================================================

void showOLED4Image(int image) {

  if (image == 1) {

    oled4.displayBitmap(
      oled4Image1
    );
  }

  else if (image == 2) {

    oled4.displayBitmap(
      oled4Image2
    );
  }

  else {

    oled4.displayBitmap(
      oled4Image3
    );
  }
}


// =====================================================
// IMAGE ROTATION
// =====================================================

void updateRotatingImages() {

  unsigned long now =
    millis();


  if (now - lastImageChange <
      IMAGE_INTERVAL) {

    return;
  }


  lastImageChange = now;


  // OLED 1

  if (oled1Image == 0) {

    oled1CurrentImage++;

    if (oled1CurrentImage > 3) {
      oled1CurrentImage = 1;
    }

    showOLED1Image(
      oled1CurrentImage
    );
  }


  // OLED 4

  if (oled4Image == 0) {

    oled4CurrentImage++;

    if (oled4CurrentImage > 3) {
      oled4CurrentImage = 1;
    }

    showOLED4Image(
      oled4CurrentImage
    );
  }
}


// =====================================================
// WEB PAGE
// =====================================================

void handleRoot() {

  String page = R"rawliteral(

<!DOCTYPE html>

<html>

<head>

<meta name="viewport"
content="width=device-width, initial-scale=1">

<title>ESP32 Display Controller</title>


<style>

* {
  box-sizing: border-box;
}


body {

  margin: 0;

  padding: 50px 20px 80px;

  background: #060606;

  color: #cfcfcf;

  font-family:
    "Courier New",
    Courier,
    monospace;
}


.container {

  max-width: 560px;

  margin: auto;
}


/* ---------- HEADER ---------- */

.header {

  text-align: center;

  margin-bottom: 45px;
}


.header .avatar {

  width: 84px;

  height: 84px;

  margin: 0 auto 20px;

  border: 1px solid #ff3b5c;

  border-radius: 50%;

  display: flex;

  align-items: center;

  justify-content: center;

  color: #ff3b5c;

  font-size: 11px;

  letter-spacing: 2px;

  opacity: 0.8;
}


h1 {

  margin: 0;

  font-size: 20px;

  letter-spacing: 6px;

  font-weight: normal;

  text-transform: uppercase;

  color: #eaeaea;
}


.subtitle {

  margin-top: 10px;

  font-size: 12px;

  letter-spacing: 2px;

  color: #ff3b5c;

  text-transform: uppercase;
}


.status-line {

  margin-top: 18px;

  font-size: 11px;

  letter-spacing: 2px;

  color: #00ff9c;

  text-transform: uppercase;
}


.status-line::before {

  content: "\25CF  ";
}


/* ---------- SECTION LABEL ---------- */

.section-label {

  display: flex;

  align-items: center;

  gap: 10px;

  margin: 40px 0 18px;

  font-size: 11px;

  letter-spacing: 3px;

  color: #888;

  text-transform: uppercase;
}


.section-label span.arrow {

  color: #ff3b5c;
}


.section-label .line {

  flex: 1;

  height: 1px;

  background: linear-gradient(
    to right,
    rgba(255,59,92,0.5),
    rgba(255,59,92,0)
  );
}


/* ---------- PANEL ---------- */

.panel {

  border: 1px solid rgba(255,59,92,0.35);

  background: rgba(255,255,255,0.015);

  border-radius: 4px;

  padding: 26px 28px;

  margin-bottom: 22px;
}


.panel h2 {

  margin: 0 0 20px;

  font-size: 13px;

  letter-spacing: 3px;

  text-transform: uppercase;

  color: #ff3b5c;

  font-weight: normal;

  display: flex;

  align-items: center;

  gap: 8px;
}


.panel h2::before {

  content: "\25B8";

  color: #ff3b5c;
}


label {

  display: block;

  font-size: 10px;

  letter-spacing: 2px;

  text-transform: uppercase;

  color: #777;

  margin-bottom: 8px;

  margin-top: 18px;
}


label:first-of-type {

  margin-top: 0;
}


input,
select {

  width: 100%;

  padding: 14px 16px;

  border: 1px solid #2a2a2a;

  border-radius: 3px;

  background: #0c0c0c;

  color: #e6e6e6;

  font-size: 14px;

  font-family: inherit;

  letter-spacing: 1px;

  appearance: none;

  -webkit-appearance: none;
}


select {

  background-image: linear-gradient(45deg, transparent 50%, #ff3b5c 50%),
    linear-gradient(135deg, #ff3b5c 50%, transparent 50%);

  background-position: calc(100% - 20px) center, calc(100% - 14px) center;

  background-size: 6px 6px, 6px 6px;

  background-repeat: no-repeat;
}


input:focus,
select:focus {

  outline: none;

  border-color: #ff3b5c;
}


input::placeholder {

  color: #555;
}


button {

  width: 100%;

  padding: 16px;

  margin-top: 22px;

  border: 1px solid #ff3b5c;

  border-radius: 3px;

  background: transparent;

  color: #ff3b5c;

  font-size: 12px;

  letter-spacing: 3px;

  text-transform: uppercase;

  font-family: inherit;

  cursor: pointer;

  transition: 0.15s ease;
}


button:hover {

  background: #ff3b5c;

  color: #0a0a0a;
}


/* ---------- READOUT (clock / temp) ---------- */

.readout {

  text-align: center;

  border: 1px solid #1c1c1c;

  border-radius: 3px;

  background: #0a0a0a;

  padding: 22px;
}


.readout .value {

  font-size: 34px;

  letter-spacing: 4px;

  color: #00ff9c;

  text-shadow: 0 0 12px rgba(0,255,156,0.25);
}


.readout .caption {

  margin-top: 8px;

  font-size: 11px;

  letter-spacing: 2px;

  color: #666;

  text-transform: uppercase;
}


/* ---------- FOOTER ---------- */

.footer {

  margin-top: 50px;

  text-align: center;

  font-size: 10px;

  letter-spacing: 2px;

  color: #444;

  text-transform: uppercase;
}

</style>

</head>


<body>


<div class="container">


<div class="header">

<div class="avatar">ESP32</div>

<h1>Display Controller</h1>

<div class="subtitle">Digital Workshop / Panel</div>

<div class="status-line">Connected</div>

</div>


<!-- CLOCK -->

<div class="section-label">
<span class="arrow">&#9656;</span>
<span>Clock</span>
<span class="line"></span>
</div>

<div class="panel">

<div class="readout">
<div class="value" id="clock">--:--</div>
<div class="caption" id="date">--/--/----</div>
</div>

<button onclick="syncTime()">Sync Laptop Time</button>

</div>


<!-- WEATHER -->

<div class="section-label">
<span class="arrow">&#9656;</span>
<span>Bangalore Temperature</span>
<span class="line"></span>
</div>

<div class="panel">

<div class="readout">
<div class="value" id="temperature">-- &deg;C</div>
<div class="caption">Automatically Updated</div>
</div>

</div>


<!-- OLED 1 -->

<div class="section-label">
<span class="arrow">&#9656;</span>
<span>OLED 1</span>
<span class="line"></span>
</div>

<div class="panel">

<h2>Image</h2>

<select id="oled1">

<option value="0">Auto Rotate</option>

<option value="1">Image 1</option>

<option value="2">Image 2</option>

<option value="3">Image 3</option>

</select>

<button onclick="setOLED1()">Apply</button>

</div>


<!-- OLED 4 -->

<div class="section-label">
<span class="arrow">&#9656;</span>
<span>OLED 4</span>
<span class="line"></span>
</div>

<div class="panel">

<h2>Image</h2>

<select id="oled4">

<option value="0">Auto Rotate</option>

<option value="1">Image 1</option>

<option value="2">Image 2</option>

<option value="3">Image 3</option>

</select>

<button onclick="setOLED4()">Apply</button>

</div>


<!-- LCD -->

<div class="section-label">
<span class="arrow">&#9656;</span>
<span>LCD</span>
<span class="line"></span>
</div>

<div class="panel">

<label>Row 1</label>

<input id="lcd1" maxlength="16" placeholder="Maximum 16 characters">

<label>Row 2</label>

<input id="lcd2" maxlength="16" placeholder="Maximum 16 characters">

<button onclick="setLCD()">Update LCD</button>

</div>


<div class="footer">ESP32 &middot; Local Network &middot; v1.0</div>


</div>


<script>


// =====================================================
// OLED 1
// =====================================================

function setOLED1() {

  let value =
    document.getElementById(
      "oled1"
    ).value;


  fetch(
    "/oled1?image=" + value
  );
}


// =====================================================
// OLED 4
// =====================================================

function setOLED4() {

  let value =
    document.getElementById(
      "oled4"
    ).value;


  fetch(
    "/oled4?image=" + value
  );
}


// =====================================================
// LCD
// =====================================================

function setLCD() {

  let line1 =
    document.getElementById(
      "lcd1"
    ).value;


  let line2 =
    document.getElementById(
      "lcd2"
    ).value;


  fetch(
    "/lcd?line1=" +
    encodeURIComponent(line1) +
    "&line2=" +
    encodeURIComponent(line2)
  );
}


// =====================================================
// TIME SYNC
// =====================================================

function syncTime() {

  let now =
    new Date();


  let data = {

    hour: now.getHours(),

    minute: now.getMinutes(),

    second: now.getSeconds(),

    day: now.getDate(),

    month: now.getMonth() + 1,

    year: now.getFullYear()
  };


  fetch(
    "/time?" +
    new URLSearchParams(data)
  );
}


// =====================================================
// UPDATE TIME AUTOMATICALLY
// =====================================================

function automaticTimeSync() {

  syncTime();

}


// Sync immediately

automaticTimeSync();


// Sync every 30 seconds

setInterval(
  automaticTimeSync,
  30000
);


// =====================================================
// UPDATE WEATHER
// =====================================================

async function updateWeather() {

  try {

    const response =
      await fetch(
        "https://api.open-meteo.com/v1/forecast?latitude=12.9716&longitude=77.5946&current=temperature_2m&timezone=Asia%2FKolkata"
      );


    const data =
      await response.json();


    const temp =
      data.current.temperature_2m;


    document.getElementById(
      "temperature"
    ).innerText =
      temp + " °C";


    // Send temperature to ESP32

    fetch(
      "/temperature?value=" +
      encodeURIComponent(temp)
    );

  }

  catch (error) {

    console.log(
      "Weather error:",
      error
    );

  }

}


// Get weather immediately

updateWeather();


// Refresh every 5 minutes

setInterval(
  updateWeather,
  300000
);


</script>


</body>

</html>

)rawliteral";


  server.send(
    200,
    "text/html",
    page
  );
}


// =====================================================
// OLED 1 WEB HANDLER
// =====================================================

void handleOLED1() {

  if (!server.hasArg("image")) {

    server.send(
      400,
      "text/plain",
      "Missing image"
    );

    return;
  }


  oled1Image =
    server.arg("image").toInt();


  if (oled1Image == 0) {

    oled1CurrentImage = 1;

    showOLED1Image(
      oled1CurrentImage
    );

  }

  else {

    showOLED1Image(
      oled1Image
    );
  }


  server.send(
    200,
    "text/plain",
    "OLED 1 updated"
  );
}


// =====================================================
// OLED 4 WEB HANDLER
// =====================================================

void handleOLED4() {

  if (!server.hasArg("image")) {

    server.send(
      400,
      "text/plain",
      "Missing image"
    );

    return;
  }


  oled4Image =
    server.arg("image").toInt();


  if (oled4Image == 0) {

    oled4CurrentImage = 1;

    showOLED4Image(
      oled4CurrentImage
    );

  }

  else {

    showOLED4Image(
      oled4Image
    );
  }


  server.send(
    200,
    "text/plain",
    "OLED 4 updated"
  );
}


// =====================================================
// LCD WEB HANDLER
// =====================================================

void handleLCD() {

  if (server.hasArg("line1")) {

    lcdLine1 =
      server.arg("line1");
  }


  if (server.hasArg("line2")) {

    lcdLine2 =
      server.arg("line2");
  }


  // Make absolutely sure the lines
  // don't exceed 16 characters.

  if (lcdLine1.length() > 16) {

    lcdLine1 =
      lcdLine1.substring(0, 16);
  }


  if (lcdLine2.length() > 16) {

    lcdLine2 =
      lcdLine2.substring(0, 16);
  }


  updateLCD();


  server.send(
    200,
    "text/plain",
    "LCD updated"
  );
}


// =====================================================
// TIME WEB HANDLER
// =====================================================

void handleTime() {

  if (
    !server.hasArg("hour") ||
    !server.hasArg("minute") ||
    !server.hasArg("second") ||
    !server.hasArg("day") ||
    !server.hasArg("month") ||
    !server.hasArg("year")
  ) {

    server.send(
      400,
      "text/plain",
      "Missing time data"
    );

    return;
  }


  currentHour =
    server.arg("hour").toInt();


  currentMinute =
    server.arg("minute").toInt();


  currentSecond =
    server.arg("second").toInt();


  currentDay =
    server.arg("day").toInt();


  currentMonth =
    server.arg("month").toInt();


  currentYear =
    server.arg("year").toInt();


  timeReceived = true;


  lastLocalSecond =
    millis();


  refreshOLED2();

  refreshOLED3();


  server.send(
    200,
    "text/plain",
    "Time synchronized"
  );
}


// =====================================================
// TEMPERATURE WEB HANDLER
// =====================================================

void handleTemperature() {

  if (!server.hasArg("value")) {

    server.send(
      400,
      "text/plain",
      "Missing temperature"
    );

    return;
  }


  temperature =
    server.arg("value").toFloat();


  temperatureReceived =
    true;


  lastTemperatureUpdate =
    millis();


  refreshOLED3();


  server.send(
    200,
    "text/plain",
    "Temperature updated"
  );
}


// =====================================================
// 404
// =====================================================

void handleNotFound() {

  server.send(
    404,
    "text/plain",
    "Not found"
  );
}


// =====================================================
// SETUP
// =====================================================

void setup() {

  Serial.begin(115200);

  delay(1000);


  Serial.println();

  Serial.println(
    "================================"
  );

  Serial.println(
    "ESP32 DISPLAY CONTROLLER"
  );

  Serial.println(
    "================================"
  );


  // ===================================================
  // LCD
  // ===================================================

  Wire.begin(18, 19);

  lcd.init();

  lcd.backlight();

  lcd.clear();

  lcd.setCursor(0, 0);

  lcd.print("Connecting WiFi");


  // ===================================================
  // OLED INITIALIZATION
  // ===================================================

  Serial.println(
    "Initializing OLEDs..."
  );


  oled1.initOLED();

  oled2.initOLED();

  oled3.initOLED();

  oled4.initOLED();


  Serial.println(
    "OLEDs initialized."
  );


  // ===================================================
  // INITIAL IMAGES
  // ===================================================

  oled1CurrentImage = 1;

  oled4CurrentImage = 1;


  showOLED1Image(
    oled1CurrentImage
  );


  showOLED4Image(
    oled4CurrentImage
  );


  // ===================================================
  // WIFI
  // ===================================================

  WiFi.mode(WIFI_STA);

  WiFi.begin(
    WIFI_SSID,
    WIFI_PASSWORD
  );


  Serial.print(
    "Connecting to Wi-Fi"
  );


  while (
    WiFi.status() != WL_CONNECTED
  ) {

    delay(500);

    Serial.print(".");
  }


  Serial.println();

  Serial.println(
    "Wi-Fi connected!"
  );


  Serial.print(
    "IP address: "
  );

  Serial.println(
    WiFi.localIP()
  );


  // ===================================================
  // LCD READY
  // ===================================================

  lcd.clear();

  lcd.setCursor(0, 0);

  lcd.print("WiFi Connected");


  lcd.setCursor(0, 1);

  lcd.print(
    WiFi.localIP().toString()
  );


  // ===================================================
  // WEB SERVER ROUTES
  // ===================================================

  server.on(
    "/",
    handleRoot
  );


  server.on(
    "/oled1",
    handleOLED1
  );


  server.on(
    "/oled4",
    handleOLED4
  );


  server.on(
    "/lcd",
    handleLCD
  );


  server.on(
    "/time",
    handleTime
  );


  server.on(
    "/temperature",
    handleTemperature
  );


  server.onNotFound(
    handleNotFound
  );


  server.begin();


  Serial.println(
    "Web server started!"
  );


  Serial.print(
    "Open: http://"
  );

  Serial.print(
    WiFi.localIP()
  );

  Serial.println(
    "/"
  );


  // ===================================================
  // START IMAGE ROTATION TIMER
  // ===================================================

  lastImageChange =
    millis();


  // ===================================================
  // INITIAL DISPLAY UPDATE
  // ===================================================

  refreshOLED2();

  refreshOLED3();

  updateLCD();
}


// =====================================================
// LOOP
// =====================================================

void loop() {

  // Handle browser requests

  server.handleClient();


  // Keep clock running

  advanceTime();


  // Rotate OLED images

  updateRotatingImages();


  // Update OLED clock displays every second

  static unsigned long lastDisplayUpdate = 0;


  if (
    millis() - lastDisplayUpdate >= 1000
  ) {

    lastDisplayUpdate =
      millis();


    if (timeReceived) {

      refreshOLED2();

      refreshOLED3();
    }
  }
}
